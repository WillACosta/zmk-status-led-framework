## Kconfig
```kconfig
menuconfig ZMK_STATUS_LED
	bool "ZMK Status LED Framework"
	default n
	depends on LED_STRIP
	help
	  Enable the event-driven ZMK Status LED Framework.

if ZMK_STATUS_LED

config STATUS_LED_BRIGHTNESS
	int "Default Status LED Brightness"
	default 20
	range 0 100
	help
	  Default brightness scale percentage (0-100) for the status LEDs.

config STATUS_LED_SIDE_LEFT
	bool "Left Side Status LED Mapping"
	default n
	help
	  Enable mapping of logical LEDs onto the left half of a split keyboard.

config STATUS_LED_SIDE_RIGHT
	bool "Right Side Status LED Mapping"
	default n
	help
	  Enable mapping of logical LEDs onto the right half of a split keyboard.

# Physical LED index mappings for Left Logical LEDs
config STATUS_LED_LEFT_OUTER_IDX
	int "Physical LED index for Left Outer logical LED"
	default 0

config STATUS_LED_LEFT_CENTER_IDX
	int "Physical LED index for Left Center logical LED"
	default 1

config STATUS_LED_LEFT_INNER_IDX
	int "Physical LED index for Left Inner logical LED"
	default 2

# Physical LED index mappings for Right Logical LEDs
config STATUS_LED_RIGHT_INNER_IDX
	int "Physical LED index for Right Inner logical LED"
	default 3

config STATUS_LED_RIGHT_CENTER_IDX
	int "Physical LED index for Right Center logical LED"
	default 4

config STATUS_LED_RIGHT_OUTER_IDX
	int "Physical LED index for Right Outer logical LED"
	default 5

# Custom Layer Colors config
config STATUS_LED_LAYER_DEFAULT_COLOR_HEX
	hex "Default Layer Change Color (RGB hex)"
	default 0x00FF00 # Green

config STATUS_LED_LAYER_1_COLOR_HEX
	hex "Layer 1 Change Color (RGB hex)"
	default 0x0000FF # Blue

config STATUS_LED_LAYER_2_COLOR_HEX
	hex "Layer 2 Change Color (RGB hex)"
	default 0xFF00FF # Magenta

config STATUS_LED_LAYER_3_COLOR_HEX
	hex "Layer 3 Change Color (RGB hex)"
	default 0xFFFF00 # Yellow

endif
```

## dts/bindings/behaviors/zmk,behavior-status-led-battery.yaml
```yaml
description: ZMK Status LED Battery Check behavior

compatible: "zmk,behavior-status-led-battery"

properties:
  label:
    type: string
    required: true
  "#binding-cells":
    type: int
    const: 0
```
